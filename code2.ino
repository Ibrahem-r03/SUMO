#include <EEPROM.h>
#include "esp32-hal-cpu.h"

// =====================================================
//                إعدادات المحركات
// =====================================================

// كل محرك له:
// [0] = RPWM
// [1] = LPWM

// 3 محركات جهة اليسار
const int LEFT_MOTORS[3][2] = {
  {18, 4},    // Left Motor 1
  {22, 23},   // Left Motor 2
  {16, 17}    // Left Motor 3
};

// 3 محركات جهة اليمين
const int RIGHT_MOTORS[3][2] = {
  {21, 19},   // Right Motor 1
  {26, 27},   // Right Motor 2
  {13, 14}    // Right Motor 3
};


// =====================================================
//                  الحساسات
// =====================================================

// حساسات الخصم:
// Front, Right, Left
const int SENSORS[3] = {
  32,  // Front
  33,  // Right
  25   // Left
};

// حساسات الخط Analog
const int LINE[4] = {
  36,
  39,
  34,
  35
};


// =====================================================
//                إعدادات الروبوت
// =====================================================

const float LEARNING_RATE = 0.01;

const float EPSILON_MIN = 0.05;

const float EDGE_THRESHOLD = 0.8;

// أوقات تجنب الحافة بالـ millisecond
const unsigned long AVOID_TIMINGS[3] = {
  50,   // توقف
  200,  // رجوع
  300   // دوران
};

// انتظار 5 ثواني قبل الحركة
const unsigned long START_DELAY = 5000;


// =====================================================
//              متغيرات الذكاء الاصطناعي
// =====================================================

// عندنا:
//
// 8 Inputs
// ×
// 6 Actions
//
// = 48 Weights

float weights[48];


// 8 Inputs:
//
// 0 = Front
// 1 = Right
// 2 = Left
//
// 3 = Line 1
// 4 = Line 2
// 5 = Line 3
// 6 = Line 4
//
// 7 = Enemy Direction

float sensorsValues[8];


// نسبة الاستكشاف تبدأ من 20%
float epsilon = 0.2;


// إحصائيات
int wins = 0;
int battles = 0;


// =====================================================
//                   حالة البداية
// =====================================================

unsigned long startTime;

bool started = false;


// =====================================================
//               حالة تجنب الحافة
// =====================================================

struct EdgeAvoid {

  bool active = false;

  int step = 0;

  unsigned long start = 0;

} edgeAvoid;


// =====================================================
//            تعريف الدوال مسبقاً
// =====================================================

void saveAI();
void loadAI();


// =====================================================
//             التحكم بمحرك واحد
// =====================================================

void driveMotor(int rpwm, int lpwm, int speedValue) {

  // حماية القيمة
  speedValue = constrain(speedValue, -255, 255);


  // ==========================
  // أمام
  // ==========================

  if (speedValue > 0) {

    analogWrite(rpwm, speedValue);

    analogWrite(lpwm, 0);
  }


  // ==========================
  // خلف
  // ==========================

  else if (speedValue < 0) {

    analogWrite(rpwm, 0);

    analogWrite(lpwm, abs(speedValue));
  }


  // ==========================
  // توقف
  // ==========================

  else {

    analogWrite(rpwm, 0);

    analogWrite(lpwm, 0);
  }
}


// =====================================================
//             التحكم بالـ 6 محركات
// =====================================================

void setMotors(int left, int right) {

  // --------------------------
  // الثلاثة محركات اليسار
  // --------------------------

  for (int i = 0; i < 3; i++) {

    driveMotor(
      LEFT_MOTORS[i][0],
      LEFT_MOTORS[i][1],
      left
    );
  }


  // --------------------------
  // الثلاثة محركات اليمين
  // --------------------------

  for (int i = 0; i < 3; i++) {

    driveMotor(
      RIGHT_MOTORS[i][0],
      RIGHT_MOTORS[i][1],
      right
    );
  }
}


// =====================================================
//                  إيقاف الروبوت
// =====================================================

void stopMotors() {

  setMotors(0, 0);
}


// =====================================================
//                 قراءة الحساسات
// =====================================================

void readSensors() {

  // =========================================
  // حساسات الخصم Digital
  // =========================================

  for (int i = 0; i < 3; i++) {

    sensorsValues[i] =
      digitalRead(SENSORS[i]);
  }


  // =========================================
  // حساسات الخط Analog
  // نحول القراءة من:
  //
  // 0 → 4095
  //
  // إلى:
  //
  // 0.0 → 1.0
  // =========================================

  for (int i = 0; i < 4; i++) {

    sensorsValues[3 + i] =
      analogRead(LINE[i]) / 4095.0;
  }


  // =========================================
  // اتجاه الخصم التقريبي
  //
  // ليس زاوية حقيقية بالدرجات
  // =========================================

  if (sensorsValues[1] > sensorsValues[2]) {

    sensorsValues[7] = 0.25;
  }

  else {

    sensorsValues[7] = 0.75;
  }
}


// =====================================================
//              اتخاذ القرار الذكي
// =====================================================

int aiDecision() {

  // =========================================
  // Exploration
  //
  // اختيار حركة عشوائية حسب epsilon
  // =========================================

  if (random(1000) < epsilon * 1000) {

    return random(0, 6);
  }


  // =========================================
  // Exploitation
  //
  // حساب Score لكل Action
  // =========================================

  float scores[6] = {
    0, 0, 0, 0, 0, 0
  };


  // عندنا 6 Actions

  for (int action = 0;
       action < 6;
       action++) {


    // عندنا 8 Inputs

    for (int i = 0;
         i < 8;
         i++) {


      // كل Action له أوزانه الخاصة

      scores[action] +=
        sensorsValues[i]
        *
        weights[i * 6 + action];
    }
  }


  // =========================================
  // اختيار أعلى Score
  // =========================================

  int best = 0;


  for (int i = 1; i < 6; i++) {

    if (scores[i] > scores[best]) {

      best = i;
    }
  }


  return best;
}


// =====================================================
//                 تنفيذ الحركة
// =====================================================

void executeAction(int action) {

  switch (action) {


    // =======================================
    // Action 0
    // توقف
    // =======================================

    case 0:

      stopMotors();

      break;


    // =======================================
    // Action 1
    // هجوم مستقيم
    // =======================================

    case 1:

      setMotors(255, 255);

      break;


    // =======================================
    // Action 2
    // انحراف جهة
    // =======================================

    case 2:

      setMotors(150, 255);

      break;


    // =======================================
    // Action 3
    // انحراف الجهة الثانية
    // =======================================

    case 3:

      setMotors(255, 150);

      break;


    // =======================================
    // Action 4
    // دوران حول نفسه
    // =======================================

    case 4:

      setMotors(-100, 100);

      break;


    // =======================================
    // Action 5
    // رجوع للخلف
    // =======================================

    case 5:

      setMotors(-200, -200);

      break;
  }
}


// =====================================================
//                حساب المكافأة
// =====================================================

float getReward(int action) {

  float reward = 0;


  // =========================================
  // وجود الخصم أمام الروبوت
  // =========================================

  reward +=
    sensorsValues[0] * 10;


  // =========================================
  // مكافأة إضافية
  // =========================================

  if (
    (action == 2 || action == 3)
    &&
    sensorsValues[0] > 0.5
  ) {

    reward += 20;
  }


  // =========================================
  // معرفة أكبر قراءة بين حساسات الحافة
  // =========================================

  float maxEdge = max(

    max(
      sensorsValues[3],
      sensorsValues[4]
    ),

    max(
      sensorsValues[5],
      sensorsValues[6]
    )
  );


  // =========================================
  // عقوبة عند اكتشاف الحافة
  // =========================================

  if (maxEdge > EDGE_THRESHOLD) {

    reward -= 30;
  }


  return reward;
}


// =====================================================
//                     التعلم
// =====================================================

void learn(
  int action,
  float reward
) {

  // =========================================
  // تحديث Weight لكل Input
  // =========================================

  for (int i = 0;
       i < 8;
       i++) {


    int index =
      i * 6 + action;


    weights[index] +=

      LEARNING_RATE
      *
      reward
      *
      sensorsValues[i];


    // منع الوزن من الخروج
    // عن النطاق -2 إلى +2

    weights[index] =
      constrain(
        weights[index],
        -2.0,
        2.0
      );
  }


  // =========================================
  // تقليل Exploration تدريجياً
  // =========================================

  epsilon *= 0.9999;


  // لا ينزل عن 5%

  if (epsilon < EPSILON_MIN) {

    epsilon = EPSILON_MIN;
  }


  // =========================================
  // حفظ دوري
  // =========================================

  static int saveCounter = 0;


  saveCounter++;


  if (saveCounter >= 100) {

    saveAI();

    saveCounter = 0;
  }
}


// =====================================================
//                  فحص الحافة
// =====================================================

bool checkEdge() {

  // sensorsValues[3]
  // إلى
  // sensorsValues[6]

  for (int i = 3;
       i < 7;
       i++) {


    if (
      sensorsValues[i]
      >
      EDGE_THRESHOLD
    ) {

      return true;
    }
  }


  return false;
}


// =====================================================
//            بدء عملية تجنب الحافة
// =====================================================

void startAvoidEdge() {

  edgeAvoid.active = true;

  edgeAvoid.step = 0;

  edgeAvoid.start = millis();


  stopMotors();
}


// =====================================================
//        تنفيذ تجنب الحافة بدون delay
// =====================================================

void handleAvoidEdge() {

  unsigned long now =
    millis();


  switch (edgeAvoid.step) {


    // =======================================
    // Step 0
    // توقف 50ms
    // =======================================

    case 0:

      if (
        now - edgeAvoid.start
        >=
        AVOID_TIMINGS[0]
      ) {

        // رجوع كامل

        setMotors(
          -255,
          -255
        );


        edgeAvoid.step = 1;

        edgeAvoid.start = now;
      }

      break;


    // =======================================
    // Step 1
    // رجوع 200ms
    // =======================================

    case 1:

      if (
        now - edgeAvoid.start
        >=
        AVOID_TIMINGS[1]
      ) {

        // دوران

        setMotors(
          -150,
          150
        );


        edgeAvoid.step = 2;

        edgeAvoid.start = now;
      }

      break;


    // =======================================
    // Step 2
    // دوران 300ms
    // =======================================

    case 2:

      if (
        now - edgeAvoid.start
        >=
        AVOID_TIMINGS[2]
      ) {

        stopMotors();


        edgeAvoid.active =
          false;
      }

      break;
  }
}


// =====================================================
//               حفظ الذكاء EEPROM
// =====================================================

void saveAI() {

  // =========================================
  // حفظ 48 Weight
  //
  // كل float = 4 Bytes
  //
  // 48 × 4 = 192 Bytes
  // =========================================

  for (int i = 0;
       i < 48;
       i++) {

    EEPROM.put(
      i * sizeof(float),
      weights[i]
    );
  }


  // بعد نهاية الـWeights

  int address =
    48 * sizeof(float);


  EEPROM.put(
    address,
    epsilon
  );


  address +=
    sizeof(float);


  EEPROM.put(
    address,
    wins
  );


  address +=
    sizeof(int);


  EEPROM.put(
    address,
    battles
  );


  EEPROM.commit();
}


// =====================================================
//              تحميل الذكاء EEPROM
// =====================================================

void loadAI() {

  for (int i = 0;
       i < 48;
       i++) {


    EEPROM.get(
      i * sizeof(float),
      weights[i]
    );


    // =======================================
    // إذا EEPROM فارغة أو القيمة غير صالحة
    // =======================================

    if (
      isnan(weights[i])
      ||
      weights[i] < -2.0
      ||
      weights[i] > 2.0
    ) {

      weights[i] =
        random(-100, 101)
        /
        100.0;
    }
  }


  int address =
    48 * sizeof(float);


  EEPROM.get(
    address,
    epsilon
  );


  address +=
    sizeof(float);


  EEPROM.get(
    address,
    wins
  );


  address +=
    sizeof(int);


  EEPROM.get(
    address,
    battles
  );


  // التحقق من epsilon

  if (
    isnan(epsilon)
    ||
    epsilon < EPSILON_MIN
    ||
    epsilon > 1.0
  ) {

    epsilon = 0.2;
  }
}


// =====================================================
//                     SETUP
// =====================================================

void setup() {

  // تشغيل ESP32 على 240 MHz

  setCpuFrequencyMhz(240);


  // EEPROM

  EEPROM.begin(512);


  // =========================================
  // إعداد الـ6 محركات
  // =========================================

  for (int i = 0;
       i < 3;
       i++) {


    // Left Motors

    pinMode(
      LEFT_MOTORS[i][0],
      OUTPUT
    );

    pinMode(
      LEFT_MOTORS[i][1],
      OUTPUT
    );


    // Right Motors

    pinMode(
      RIGHT_MOTORS[i][0],
      OUTPUT
    );

    pinMode(
      RIGHT_MOTORS[i][1],
      OUTPUT
    );
  }


  // توقف آمن عند البداية

  stopMotors();


  // =========================================
  // حساسات الخصم
  // =========================================

  for (int i = 0;
       i < 3;
       i++) {

    pinMode(
      SENSORS[i],
      INPUT
    );
  }


  // =========================================
  // حساسات الخط
  // =========================================

  for (int i = 0;
       i < 4;
       i++) {

    pinMode(
      LINE[i],
      INPUT
    );
  }


  // =========================================
  // seed للـ random
  // =========================================

  randomSeed(
    micros()
  );


  // =========================================
  // تحميل الخبرة السابقة
  // =========================================

  loadAI();


  // حفظ وقت التشغيل

  startTime =
    millis();
}


// =====================================================
//                      LOOP
// =====================================================

void loop() {

  // =========================================
  // قراءة السنسورات
  //
  // تتم في كل Loop
  // بدون Sampling Delay ثابت
  // =========================================

  readSensors();


  // =========================================
  // انتظار أول 5 ثواني
  // =========================================

  if (
    !started
    &&
    millis() - startTime
    <
    START_DELAY
  ) {

    stopMotors();

    return;
  }


  started = true;


  // =========================================
  // إذا الروبوت في وضع تجنب الحافة
  // =========================================

  if (edgeAvoid.active) {

    handleAvoidEdge();

    return;
  }


  // =========================================
  // فحص الحافة له الأولوية
  // =========================================

  if (checkEdge()) {

    startAvoidEdge();

    return;
  }


  // =========================================
  // اتخاذ القرار
  // =========================================

  int action =
    aiDecision();


  // =========================================
  // تنفيذ القرار
  // =========================================

  executeAction(action);


  // =========================================
  // حساب Reward
  // =========================================

  float reward =
    getReward(action);


  // =========================================
  // Learning
  // =========================================

  learn(
    action,
    reward
  );
}
